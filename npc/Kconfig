## npc/Kconfig
```kconfig
mainmenu "NPC Configuration Menu"

choice
  prompt "Base ISA"
  default ISA_riscv
config ISA_x86
  bool "x86"
config ISA_mips32
  bool "mips32"
config ISA_riscv
  bool "riscv"
config ISA_loongarch32r
  bool "loongarch32r"
endchoice

config ISA
  string
  default "x86" if ISA_x86
  default "mips32" if ISA_mips32
  default "riscv32" if ISA_riscv && !RV64
  default "riscv64" if ISA_riscv &&  RV64
  default "loongarch32r" if ISA_loongarch32r
  default "none"

config ISA64
  depends on ISA_riscv && RV64
  bool
  default y

choice
  prompt "NEMU execution engine"
  default ENGINE_INTERPRETER

config ENGINE_INTERPRETER
  bool "Interpreter"
  help
    Interpreter guest instructions one by one.
endchoice

config ENGINE
  string
  default "interpreter" if ENGINE_INTERPRETER
  default "none"

choice
  prompt "Running mode"
  default MODE_SYSTEM

config MODE_SYSTEM
  bool "System mode"
  help
    Support full-system functionality, including privileged instructions, MMU and devices.
endchoice

choice
  prompt "Build target"
  default TARGET_NATIVE_ELF
config TARGET_NATIVE_ELF
  bool "Executable on Linux Native"
config TARGET_SHARE
  bool "Shared object (used as REF for differential testing)"
config TARGET_AM
  bool "Application on Abstract-Machine (DON'T CHOOSE)"
endchoice

menu "Build Options"
choice
  prompt "Compiler"
  default CC_GCC
config CC_GCC
  bool "gcc"
config CC_GPP
  bool "g++"
config CC_CLANG
  depends on !TARGET_AM
  bool "clang"
endchoice

config CC
  string
  default "gcc" if CC_GCC
  default "g++" if CC_GPP
  default "clang" if CC_CLANG
  default "none"

choice
  prompt "Optimization Level"
  default CC_O2
config CC_O0
  bool "O0"
config CC_O1
  bool "O1"
config CC_O2
  bool "O2"
config CC_O3
  bool "O3"
endchoice

config CC_OPT
  string
  default "-O0" if CC_O0
  default "-O1" if CC_O1
  default "-O2" if CC_O2
  default "-O3" if CC_O3
  default "none"

config CC_LTO
  depends on !TARGET_AM
  bool "Enable link-time optimization"
  default n

config CC_DEBUG
  bool "Enable debug information"
  default n

config CC_ASAN
  depends on MODE_SYSTEM
  bool "Enable address sanitizer"
  default n
endmenu

menu "Testing and Debugging"

config WATCHPOINT
  bool "Enable watchpoint"
  default n
  
config MTRACE
  bool "Enable mtrace"
  default n

config DTRACE
  bool "Enable dtrace"
  default n

config ETRACE
  bool "Enable etrace"
  default n
  
config IRINGBUF
  bool "Enable iringbuf"
  default y

config TRACE
  bool "Enable tracer"
  default y

config NPC_OPEN_SIM
  bool "Enable wave"
  default y
  
config TRACE_START
  depends on TRACE
  int "When tracing is enabled (unit: number of instructions)"
  default 0

config TRACE_END
  depends on TRACE
  int "When tracing is disabled (unit: number of instructions)"
  default 1000

config ITRACE
  depends on TRACE && TARGET_NATIVE_ELF && ENGINE_INTERPRETER
  bool "Enable instruction tracer"
  default y
  
config FTRACE
  bool "Enable ftrace"
  default n

config PRINT_INST
  bool "Print instruction disassembly"  
  default y
  
config ITRACE_COND
  depends on ITRACE
  string "Only trace instructions when the condition is true"
  default "true"


config DIFFTEST
  depends on TARGET_NATIVE_ELF
  bool "Enable differential testing"
  default n
  help
    Enable differential testing with a reference design.
    Note that this will significantly reduce the performance of NEMU.

choice
  prompt "Reference design"
  default DIFFTEST_REF_SPIKE if ISA_riscv
  default DIFFTEST_REF_KVM if ISA_x86
  default DIFFTEST_REF_QEMU
  depends on DIFFTEST
config DIFFTEST_REF_QEMU
  bool "QEMU, communicate with socket"
if ISA_riscv
config DIFFTEST_REF_SPIKE
  bool "Spike"
endif
if ISA_x86
config DIFFTEST_REF_KVM
  bool "KVM"
endif
endchoice

config DIFFTEST_REF_PATH
  string
  default "tools/qemu-diff" if DIFFTEST_REF_QEMU
  default "tools/kvm-diff" if DIFFTEST_REF_KVM
  default "tools/spike-diff" if DIFFTEST_REF_SPIKE
  default "none"

config DIFFTEST_REF_NAME
  string
  default "qemu" if DIFFTEST_REF_QEMU
  default "kvm" if DIFFTEST_REF_KVM
  default "spike" if DIFFTEST_REF_SPIKE
  default "none"
endmenu

menu "Miscellaneous"
choice
  depends on !TARGET_AM
  prompt "Host timer"
  default TIMER_GETTIMEOFDAY
config TIMER_GETTIMEOFDAY
  bool "gettimeofday"
config TIMER_CLOCK_GETTIME
  bool "clock_gettime"
endchoice

config RT_CHECK
  bool "Enable runtime checking"
  default y

endmenu

menu "Base option"

#=====================================================
config MSIZE
    hex
    default 0x08000000

config RTC_MMIO
    hex
    default 0xa0000048

config PC_RESET_OFFSET
    hex
    default 0x0

config MEM_RANDOM
    bool
    default y

config MBASE
    hex
    default 0x80000000

config SERIAL_MMIO
    hex
    default 0xa00003f8

#soc
  #CLINT
config CLINT_BASE	
    hex
    default 0x02000000

config CLINT_BOUND
    hex
    default 0x0200ffff    

  #SRAM
config SRAM
  hex
  default 0x0f000000  
  
config SRAM_BOUND
  hex
  default 0x0fffffff 

  #UART
config UART
  hex
  default 0x10000000

config UART_BOUND
  hex
  default 0x10000fff

  #SPI master
config SPI_MASTER
  hex
  default 0x10001000

config SPI_MASTER_BOUND
  hex
  default 0x10001fff

  #GPIO
config GPIO
  hex
  default 0x10002000

config GPIO_BOUND
  hex
  default 0x1000200f  

  #PS2
config PS2
  hex 
  default 0x10011000

config PS2_BOUND
  hex
  default 0x10011000  

  #MROM
config MROM
  hex
  default 0x20000000

config MROM_BOUND
  hex
  default 0x20000fff

  #VGA
config VGA
  hex
  default 0x21000000

config VGA_BOUND
  hex
  default 0x211fffff  

  #FLASH
config FLASH
  hex
  default 0x30000000

config FLASH_BOUND
  hex
  default 0x3fffffff

  #ChipLink MMIO
config CHIPLINK_MMIO
  hex
  default 0x40000000

config CHIPLINK_MMIO_BOUND
  hex
  default 0x7fffffff

  #PSRAM
config PSRAM
  hex 
  default 0x80000000

config PSRAM_BOUND
  hex
  default 0x9fffffff

  #SDRAM
config SDRAM
  hex
  default 0xa0000000

config SDRAM_BOUND
  hex
  default 0xbfffffff

  #ChipLink MEM
config CHIPLINK_MEM
  hex
  default 0xc0000000

config CHIPLINK_MEM_BOUND
  hex
  default 0xffffffff
#===========================================================
config PMEM_GARRAY
    bool
    default y

config MULTI_CYCLE
    bool "Multi-core processor"
    default n

config PIPELINE
    bool "pipeline-core processor"
    default y
   
    
endmenu
```
